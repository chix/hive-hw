#include <Adafruit_GFX.h>
#include <Adafruit_SSD1306.h>
#include <HX711.h>
#include <Wire.h>

#define SCREEN_WIDTH 128
#define SCREEN_HEIGHT 32
#define DT_PIN 7
#define SCK_PIN 6

HX711 scale;
// Declaration for an SSD1306 display connected to I2C (SDA, SCL pins)
Adafruit_SSD1306 display(SCREEN_WIDTH, SCREEN_HEIGHT, &Wire, -1);

static const unsigned char PROGMEM bee_map[] = {
  0x00, 0x60, 0x06, 0x00, 0x00, 0x30, 0x0c, 0x00, 0x00, 0x08, 0x10, 0x00, 0x00, 0x04, 0x20, 0x00, 
  0x00, 0x07, 0xe0, 0x00, 0x00, 0x0f, 0xf8, 0x00, 0x00, 0x1c, 0x38, 0x00, 0x00, 0x38, 0x1c, 0x00, 
  0x00, 0x30, 0x0c, 0x00, 0x00, 0x30, 0x0c, 0x00, 0x00, 0x33, 0xcc, 0x00, 0x00, 0x3f, 0xfc, 0x00, 
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  0x00, 0x1e, 0x78, 0x00, 0x00, 0x0f, 0xf0, 0x00, 0x00, 0x03, 0xc0, 0x00, 0x00, 0x01, 0x80, 0x00
};
const float scale_calibration_factor = 21500.0, scale_zero_factor = 0.35;
float scale_weight;
bool debug = true;

void setup() {
  if (debug) {
    Serial.begin(9600);
  }

  // Set up display
  if(!display.begin(SSD1306_SWITCHCAPVCC, 0x3C) && debug) {
    Serial.println(F("SSD1306 allocation failed"));
    for(;;);
  }
  display.begin(SSD1306_SWITCHCAPVCC, 0x3C);
  delay(1000);
  display.clearDisplay();

  // Set up scale
  scale.begin(DT_PIN, SCK_PIN);
  scale.set_scale(scale_calibration_factor);
}

void loop() {
  delay(1000);

  // Read scale
  scale_weight = fabs(scale.get_units(3) - scale_zero_factor);

  if (debug) {
    Serial.println(scale_weight);
  }
  
  display.clearDisplay();
  
  // Draw bitmap
  display.drawBitmap(0, 0, bee_map, 32, 32, 1);
  display.display();

  // Draw text
  display.setTextSize(2);
  display.setTextColor(WHITE);
  display.setCursor(40, 12);
  display.print(scale_weight);
  display.println(" Kg");
  display.display(); 
}
